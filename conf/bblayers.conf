## conf/bblayers.conf
```bitbake
LCONF_VERSION = "6"

BBPATH = "${TOPDIR}"
BSPDIR := "${@os.path.abspath(os.path.dirname(d.getVar('FILE', True)) + '/../..')}"

BBFILES ?= ""
BBLAYERS = " \
  ${BSPDIR}/sources/poky/meta \
  ${BSPDIR}/sources/poky/meta-poky \
  \
  ${BSPDIR}/sources/meta-openembedded/meta-oe \
  ${BSPDIR}/sources/meta-openembedded/meta-multimedia \
  ${BSPDIR}/sources/meta-openembedded/meta-python \
  \
  ${BSPDIR}/sources/meta-freescale \
  ${BSPDIR}/sources/meta-freescale-3rdparty \
  ${BSPDIR}/sources/meta-freescale-distro \
  ${BSPDIR}/sources/meta-browser/meta-chromium \
  \
  ${BSPDIR}/sources/meta-swupdate \
  ${BSPDIR}/sources/meta-variscite-bsp-imx \
  ${BSPDIR}/sources/meta-variscite-sdk-imx \
  ${BSPDIR}/sources/meta-variscite-bsp-common \
  ${BSPDIR}/sources/meta-variscite-sdk-common \
  ${BSPDIR}/sources/meta-variscite-hab \
"
```
